## components/BSP/Kconfig
```kconfig
menu "Cloud Voice"

config CLOUD_TTS_PROXY_URL
    string "Cloud TTS proxy URL"
    default ""
    help
        HTTP endpoint used by the ESP32 device to fetch synthesized speech.
        The proxy is recommended to run on your LAN and handle Qwen/DashScope
        credentials server-side for better maintainability.

        Example:
          http://192.168.1.10:8000/tts

config CLOUD_CHAT_PROXY_URL
    string "Cloud Chat proxy URL"
    default ""
    help
        HTTP endpoint used by the ESP32 device to upload user audio and get
        assistant speech back (audio/wav).

        Example:
          http://192.168.1.10:8000/chat

config CLOUD_CHAT_PCM_PROXY_URL
    string "Cloud Chat PCM stream URL (low latency)"
    default ""
    help
        Optional low-latency endpoint. The ESP32 uploads user audio (audio/wav),
        and the server responds with streaming 16-bit PCM (audio/L16) so the
        device can play while the assistant is still synthesizing.

        Example:
          http://192.168.1.10:8000/chat_pcm

config CLOUD_WEBSOCKET_URL
    string "Cloud WebSocket URL (realtime streaming)"
    default ""
    help
        WebSocket endpoint for real-time bidirectional streaming voice chat.
        This provides the lowest latency: audio is streamed as you speak,
        and responses start playing before the full reply is ready.

        If set, WebSocket mode will be used instead of HTTP.

        Example:
          ws://192.168.1.10:8000/ws

config DIALOG_SESSION_TIMEOUT_MS
    int "Dialog session timeout (ms)"
    default 45000
    help
        After wake, if no user speech is detected for this long, the device
        exits dialog mode and returns to wake-word listening.

config DIALOG_END_SILENCE_MS
    int "End-of-utterance silence (ms)"
    default 450
    help
        In dialog mode, how long of silence after speech is considered as the
        end of an utterance.

config DIALOG_ENERGY_GATE_MEAN_ABS
    int "Dialog speech energy gate (mean abs)"
    default 120
    help
        Optional extra gate for dialog speech detection.
        If > 0, frames with mean(|pcm|) below this value will be treated as
        non-speech even if AFE VAD says speech. This helps:
          - reduce false "Speech start" caused by noise
          - avoid being stuck in speech (hitting max_utterance_ms)

config DIALOG_LOCAL_COMMAND_IGNORE_MS
    int "Ignore dialog audio after local command (ms)"
    default 800
    help
        In dialog mode, local commands (e.g. 开灯/关灯) should not be uploaded
        to cloud chat. After a local command is detected, dialog audio frames
        are ignored for this duration to avoid accidentally recording/uploading
        the same utterance.

config DIALOG_MAX_UTTERANCE_MS
    int "Max utterance length (ms)"
    default 8000
    help
        Hard cap to avoid very long recordings consuming memory.

endmenu
```

## sdkconfig.defaults
```kconfig
# -----------------------------------------------------------------------------
# dino_toy default config (recommended)
# -----------------------------------------------------------------------------
# Goal: a fresh clone can `idf.py set-target esp32s3` + `idf.py build` without
# opening menuconfig.
#
# Hardware assumption:
# - ESP32-S3 with 16MB flash
# - ESP-SR models stored in the `model` partition (SPIFFS)
# -----------------------------------------------------------------------------

# Target (still recommended to run: idf.py set-target esp32s3)
CONFIG_IDF_TARGET="esp32s3"

# Flash size (match 16MB partition table)
CONFIG_ESPTOOLPY_FLASHSIZE_16MB=y
CONFIG_ESPTOOLPY_FLASHSIZE="16MB"

# Partition table (includes `model` partition for ESP-SR models)
CONFIG_PARTITION_TABLE_CUSTOM=y
CONFIG_PARTITION_TABLE_CUSTOM_FILENAME="partitions-16MB.csv"
CONFIG_PARTITION_TABLE_FILENAME="partitions-16MB.csv"
CONFIG_PARTITION_TABLE_OFFSET=0x8000
CONFIG_PARTITION_TABLE_MD5=y

# -----------------------------------------------------------------------------
# ESP Speech Recognition (ESP-SR)
# -----------------------------------------------------------------------------
CONFIG_SR_NSN_WEBRTC=y
CONFIG_SR_VADN_WEBRTC=y

# WakeNet9: enable ONE wake word model (matches code/README: 小鹿，小鹿)
CONFIG_SR_WN_WN9_XIAOLUXIAOLU_TTS2=y

# MultiNet: Chinese command model (required for offline commands)
CONFIG_SR_MN_CN_MULTINET7_QUANT=y

# -----------------------------------------------------------------------------
# Audio playback (used by roar SFX + cloud TTS playback)
# -----------------------------------------------------------------------------
CONFIG_AUDIO_PLAYER_ENABLE_MP3=y
CONFIG_AUDIO_PLAYER_ENABLE_WAV=y
CONFIG_AUDIO_PLAYER_LOG_LEVEL=0

# -----------------------------------------------------------------------------
# Cloud Voice (optional) - keep empty by default
# -----------------------------------------------------------------------------
CONFIG_CLOUD_TTS_PROXY_URL=""
CONFIG_CLOUD_CHAT_PROXY_URL=""
CONFIG_CLOUD_CHAT_PCM_PROXY_URL=""

# Dialog tuning defaults
CONFIG_DIALOG_SESSION_TIMEOUT_MS=45000
CONFIG_DIALOG_END_SILENCE_MS=450
CONFIG_DIALOG_ENERGY_GATE_MEAN_ABS=120
CONFIG_DIALOG_LOCAL_COMMAND_IGNORE_MS=800
CONFIG_DIALOG_MAX_UTTERANCE_MS=8000
```
